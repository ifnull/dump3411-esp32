## boards/Kconfig
```kconfig
menu "Board"

    choice DUMP3411_BOARD
        prompt "Board"
        default DUMP3411_BOARD_GENERIC
        help
            The hardware to build for. Usually set by building with
            -D BOARD=<name>, which loads boards/sdkconfig.<name>.

        config DUMP3411_BOARD_GENERIC
            bool "Generic ESP32-S3 (no peripherals)"
            help
                Any ESP32-S3 board. Wi-Fi capture and serial output only.

        config DUMP3411_BOARD_XIAO_ESP32S3
            bool "Seeed XIAO ESP32-S3 + ePaper driver board"
            select DUMP3411_BOARD_HAS_EINK
            select DUMP3411_BOARD_HAS_BUTTONS
            select DUMP3411_BOARD_HAS_GNSS
            help
                The reference build: XIAO ESP32-S3 in Seeed's ePaper driver
                board with the 2.9" mono panel, three buttons, and an
                optional L76K GNSS module.
    endchoice

    config DUMP3411_BOARD_NAME
        string
        default "generic" if DUMP3411_BOARD_GENERIC
        default "xiao_esp32s3" if DUMP3411_BOARD_XIAO_ESP32S3

    # What the chosen board can carry. Selected by the board choice above,
    # never set by hand; boards/board.h checks the pins match.
    config DUMP3411_BOARD_HAS_EINK
        bool
    config DUMP3411_BOARD_HAS_BUTTONS
        bool
    config DUMP3411_BOARD_HAS_GNSS
        bool

    menu "Peripherals"

        config DUMP3411_ENABLE_EINK_DISPLAY
            bool "E-ink display"
            depends on DUMP3411_BOARD_HAS_EINK
            default y

        config DUMP3411_ENABLE_BUTTONS
            bool "Buttons"
            depends on DUMP3411_BOARD_HAS_BUTTONS
            default y

        config DUMP3411_ENABLE_GNSS
            bool "GNSS receiver"
            depends on DUMP3411_BOARD_HAS_GNSS
            default n
            help
                Off by default: the GNSS module is an optional add-on.

    endmenu

endmenu
```

## main/Kconfig.projbuild
```kconfig
menu "dump3411-esp32"

    config DUMP3411_WIFI_CHANNEL
        int "Wi-Fi channel to monitor (0 = hop 1-11)"
        range 0 13
        default 0
        help
            Like dump3411's --channel: a fixed channel gives full dwell time
            on a transmitter whose channel you know, at the cost of missing
            the others.

    config DUMP3411_HOP_DWELL_MS
        int "Channel hop dwell time (ms)"
        range 50 2000
        default 200
        help
            Same default as dump3411's --channel-dwell.

endmenu
```

## tools/rid-transmitter/main/Kconfig.projbuild
```kconfig
menu "RID bench transmitter"

    config RID_TX_CENTER_LAT_E7
        int "Center latitude of the simulated flight (degrees x 1e7)"
        default 398283000
        help
            Default is the geographic center of the contiguous US, an
            obviously fake spot for a bench test.

    config RID_TX_CENTER_LON_E7
        int "Center longitude of the simulated flight (degrees x 1e7)"
        default -985795000

    config RID_TX_WIFI_CHANNEL
        int "Wi-Fi channel"
        range 1 13
        default 6

    config RID_TX_WIFI_POWER_QDBM
        int "Wi-Fi max TX power, in 0.25 dBm units (8 = 2 dBm, the minimum)"
        range 8 84
        default 8

endmenu
```
